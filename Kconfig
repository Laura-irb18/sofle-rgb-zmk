## Kconfig
```kconfig
# SPDX-License-Identifier: MIT

DT_COMPAT_CODEKEEB_BATTERY_NRF_VDDH_CURVE := codekeeb,battery-nrf-vddh-curve

config CODEKEEB_BATTERY_NRF_VDDH_CURVE
    bool
    default $(dt_compat_enabled,$(DT_COMPAT_CODEKEEB_BATTERY_NRF_VDDH_CURVE))
    select ADC
    select ZMK_BATTERY
    depends on SENSOR
    help
      Driver de bateria por VDDH del nRF52 con curva de descarga LiPo
      realista en lugar de la aproximacion lineal de ZMK.

# --- RGB FX (efectos de animacion, codigo vendorizado de zmk-rgb-fx, MIT) ---

config ZMK_RGB_FX
    bool "RGB animation effects"
    depends on LED_STRIP
    help
      Sistema de animaciones RGB (ripple, sparkle, gradient, solid)
      que sustituye al underglow estandar de ZMK.

config ZMK_RGB_FX_FPS
    int "RGB effect FPS"
    range 1 60
    default 30
    depends on ZMK_RGB_FX

config ZMK_RGB_FX_PIXEL_DISTANCE
    bool "Pixel distance lookup table"
    default y
    depends on ZMK_RGB_FX
    help
      Tabla de distancias entre pixeles usada por el efecto ripple.
```

## config/west.yml
```yaml
manifest:
  remotes:
    - name: zmkfirmware
      url-base: https://github.com/zmkfirmware
    - name: codekeeb
      url-base: https://github.com/codekeeb
  projects:
    - name: zmk
      remote: zmkfirmware
      revision: v0.3
      import: app/west.yml
    # Fork with runtime animation selection (behavior &oledanim) + graphic battery
    - name: zmk-nice-oled
      remote: codekeeb
      revision: selectable
  self:
    path: config
```

## dts/bindings/behaviors/zmk,behavior-rgb-fx-layer.yaml
```yaml
# SPDX-License-Identifier: MIT

description: Internal split relay for per-layer RGB tint (not for keymaps)

compatible: "zmk,behavior-rgb-fx-layer"

include: one_param.yaml
```

## dts/bindings/behaviors/zmk,behavior-rgb-fx-sync.yaml
```yaml
# SPDX-License-Identifier: MIT

description: Internal split relay carrying the absolute RGB state (not for keymaps)

compatible: "zmk,behavior-rgb-fx-sync"

include: one_param.yaml
```

## dts/bindings/sensor/codekeeb,battery-nrf-vddh-curve.yaml
```yaml
# SPDX-License-Identifier: MIT

description: Battery SoC monitoring using nRF VDDH with a realistic LiPo discharge curve

compatible: "codekeeb,battery-nrf-vddh-curve"
```

## dts/bindings/zmk,rgb-fx-heatmap.yaml
```yaml
# SPDX-License-Identifier: MIT

description: |
  Keys light up when pressed and fade out, leaving a typing trail.

compatible: "zmk,rgb-fx-heatmap"

include: rgb-fx-base.yaml

properties:
  color:
    type: int
    required: true
    description: Glow color in HSL format.

  duration:
    type: int
    default: 1200
    description: Fade-out time in milliseconds.
```
